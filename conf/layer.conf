## conf/layer.conf
```bitbake
BBPATH .= ":${LAYERDIR}"
BBFILES += "\
            ${LAYERDIR}/recipes-*/*/*.bb \
            ${LAYERDIR}/recipes-*/*/*.bbappend \
           "

BBFILE_COLLECTIONS += "cmf-mesh"
BBFILE_PATTERN_cmf-mesh := "^${LAYERDIR}/"
#BBFILE_PRIORITY_cmf-mesh = "25"

LAYERSERIES_COMPAT_cmf-mesh = "dunfell"

LAYERDEPENDS_cmf-mesh = "cmf-broadband"
```
